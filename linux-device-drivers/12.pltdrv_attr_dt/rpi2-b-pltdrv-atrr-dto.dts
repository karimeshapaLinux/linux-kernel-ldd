/dts-v1/;
/plugin/;

/{
	fragment@0 {
		target = <&pltdev0>;
		__overlay__ {
			status = "disabled";
		};
	};

	fragment@1 {
		target = <&pltdev1>;
		__overlay__ {
			org,version = <0xCC>;
		};
	};
};
